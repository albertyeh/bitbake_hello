## meta-tym/conf/layer.conf
```bitbake
# We have a conf and classes directory, add to BBPATH
BBPATH .= ":${LAYERDIR}"

# We have recipes-* directories, add to BBFILES
BBFILES += "${LAYERDIR}/recipes-*/*/*.bb ${LAYERDIR}/recipes-*/*/*.bbappend"

BBFILE_COLLECTIONS += "meta-tym2"
BBFILE_PATTERN_meta-tym2 = "^${LAYERDIR}/"
BBFILE_PRIORITY_meta-tym2 = "1"

# This should only be incremented on significant changes that will
# cause compatibility issues with other layers
LAYERVERSION_meta-tym2 = "1"

#LAYERDEPENDS_meta-tym2 = "core"

LAYERSERIES_COMPAT_meta-tym2 = "rocko"
```
